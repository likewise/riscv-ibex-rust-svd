# Ibex register map
Vendor: lowRISC
Registers are 32-bit, read-write, reset 0x0 unless marked. A register's access mark holds for its fields unless they carry their own. Offsets are from the block's base; lines under a group give offsets from that group; [hi:lo] are bit positions; {n}, {i} and the like mark numbered series; 'fields as' and 'values as' point back to an identical list; <NAME> marks a mode.

## Memory map
0x80000000 GPIO0 size 0x100 — GPIO

## GPIO0 — GPIO
Base 0x80000000
0x00 OUT — GPIO port output type register
  [0] LED0 — PL LED 0
